#define BLYNK_TEMPLATE_ID "TMPL6TzqGSnv8"
#define BLYNK_TEMPLATE_NAME "Quickstart Template"
#define BLYNK_AUTH_TOKEN "Tqa-DWJK-fIE8-eLqK2K-fDNEqqbfzT2"

#include <Wire.h>
#include <SPI.h>
#include <Adafruit_MLX90614.h>
#include <HardwareSerial.h>
#include <Adafruit_GFX.h>
#include <Adafruit_ST7735.h>
#include <Arduino.h>
#include <HardwareSerial.h>
#include <WiFi.h>
#include <WiFiClient.h>
#include <BlynkSimpleEsp32.h>
#include <string.h>


Adafruit_MLX90614 mlx = Adafruit_MLX90614();
// Cấu hình UART
#define RX_PIN 16  // Chân RX của ESP32
#define TX_PIN 17  // Chân TX của ESP32
HardwareSerial SerialPort(2);  // Sử dụng UART1


// chân kết nối TFT
#define TFT_CS      27
#define TFT_RST     26
#define TFT_DC      25
#define TFT_MOSI    23
#define TFT_SCLK    18
#define TFT_LED     -1

//------------Dinh nghia mau sac----------------
#define BLACK 0x0000    
#define BLUE 0x001F    
#define RED 0xF800      
#define GREEN 0x07E0
#define CYAN 0x07FF
#define MAGENTA 0xF81F  
#define YELLOW 0xFFE0
#define WHITE 0xFFFF 

Adafruit_ST7735 tft = Adafruit_ST7735(TFT_CS, TFT_DC, TFT_RST);



char auth[] = BLYNK_AUTH_TOKEN;

char ssid[] = "Newt";
char password[] = "quyanhhoang2k3";


#define SOUND_SPEED 0.034
const int trigPin = 32;
const int echoPin = 33;
const int buzzer = 14;

float roomTemp; // nhiệt độ môi trường
float objectTemp, temp; // nhiệt độ dối tượng

int readCount = 0; // số lần đo
float measurementError= 2.6 ; // sai số cảm biến nhiệt

int maximumRange = 10; // Khoảng cách tối đa
int minimumRange = 2; // Khoảng cách tối thiểu
long duration;
float distance; 
int delayTime; 

char disTemp[10];


const unsigned char NhietDo [] PROGMEM = {
	0x00, 0xf0, 0x00, 0x00, 0x90, 0x00, 0x01, 0x08, 0x00, 0x01, 0x08, 0x00, 0x01, 0x08, 0x00, 0x01, 
	0x08, 0x00, 0x01, 0x08, 0x00, 0x01, 0x08, 0x00, 0x01, 0x0c, 0x00, 0x01, 0x08, 0x00, 0x01, 0x08, 
	0x00, 0x01, 0x08, 0x00, 0x01, 0x08, 0x00, 0x01, 0x08, 0x00, 0x01, 0x0c, 0x00, 0x01, 0x08, 0x00, 
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	0xf6, 0x00, 0x03, 0x0c, 0x00, 0x00, 0xf0, 0x00
};

const unsigned short Warning[720] PROGMEM={
0x0000, 0x0000, 0x0000, 0x0000, 0x0000, 0x0000, 0x0000, 0x0000, 0x0000, 0x0000, 0x0000, 0x0000, 0x0000, 0x7000, 0xD000, 0xD000,   // 0x0010 (16) pixels
0x7000, 0x0000, 0x0000, 0x0000, 0x0000, 0x0000, 0x0000, 0x0000, 0x0000, 0x0000, 0x0000, 0x0000, 0x0000, 0x0000, 0x0000, 0x0000,   // 0x0020 (32) pixels
0x0000, 0x0000, 0x0000, 0x0000, 0x0000, 0x0000, 0x0000, 0x0000, 0x0000, 0x0000, 0x4800, 0xD000, 0xD800, 0xD800, 0xD000, 0x4800,   // 0x0030 (48) pixels
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0xD800, 0xD800, 0xD800, 0xD800, 0xD800, 0xD800, 0xD800, 0xD800, 0xD800, 0xD800, 0xD800, 0xD800, 0xD800, 0xD800, 0xC800, 0x7000,   // 0x02D0 (720) pixels
};

const unsigned short Loading[5376] PROGMEM={
0x0020, 0x0020, 0x0020, 0x0020, 0x0020, 0x0020, 0x0020, 0x0020, 0x0020, 0x0020, 0x0020, 0x0020, 0x0020, 0x0020, 0x0020, 0x0020,   // 0x0010 (16) pixels
0x0020, 0x0020, 0x0020, 0x0020, 0x0020, 0x0020, 0x0020, 0x0020, 0x0020, 0x0020, 0x0020, 0x0020, 0x0020, 0x0020, 0x0020, 0x0020,   // 0x0020 (32) pixels
0x0020, 0x0020, 0x0020, 0x0020, 0x0020, 0x0020, 0x0020, 0x0020, 0x0020, 0x0020, 0x0020, 0x0020, 0x0020, 0x0020, 0x0020, 0x0020,   // 0x0030 (48) pixels
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0x0020, 0x0020, 0x0020, 0x0020, 0x0020, 0x0020, 0x0020, 0x0020, 0x0020, 0x0020, 0x0020, 0x0020, 0x0020, 0x0020, 0x0020, 0x0020,   // 0x1500 (5376) pixels
};

const unsigned short Virus[900] PROGMEM={
0x0000, 0x0000, 0x0000, 0x0000, 0x0000, 0x0000, 0x0000, 0x0000, 0x0000, 0x1020, 0x0000, 0x0000, 0x8165, 0xFACA, 0xFA8B, 0xF92B,   // 0x0010 (16) pixels
0xF8EB, 0x8065, 0x0000, 0x0000, 0x0800, 0x0000, 0x0000, 0x0000, 0x0000, 0x0000, 0x0000, 0x0000, 0x0000, 0x0000, 0x0000, 0x0000,   // 0x0020 (32) pixels
0x0000, 0x0000, 0x0000, 0x0000, 0x0000, 0x1841, 0x7965, 0xC228, 0x38A2, 0x0000, 0x50E3, 0xBA08, 0xF20A, 0xE8CA, 0xB888, 0x5043,   // 0x0030 (48) pixels
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0x0000, 0x0000, 0x0000, 0x0000
};

const unsigned short TichXanh[900] PROGMEM={
0x0000, 0x0000, 0x0000, 0x0000, 0x0000, 0x0000, 0x0000, 0x0000, 0x0000, 0x0000, 0x0000, 0x0000, 0x0000, 0x0000, 0x0000, 0x0000,   // 0x0010 (16) pixels
0x0000, 0x0000, 0x0000, 0x0000, 0x0000, 0x0000, 0x0000, 0x0000, 0x0000, 0x0000, 0x0000, 0x0000, 0x0000, 0x0000, 0x0000, 0x0000,   // 0x0020 (32) pixels
0x0000, 0x0000, 0x0000, 0x0000, 0x0000, 0x0000, 0x0000, 0x0000, 0x0000, 0x0000, 0x0000, 0x0000, 0x0000, 0x0000, 0x0000, 0x0000,   // 0x0030 (48) pixels
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0x0000, 0x0000, 0x0000, 0x0000
};

void initWifi(){
  WiFi.mode(WIFI_STA);
  WiFi.begin(ssid, password);
  Serial.println("Connecting to wifi ... ");
  while(WiFi.status() != WL_CONNECTED){
    Serial.print(".");
    delay(1000);
  }
  Serial.println(WiFi.localIP());
}

void XoaHienThi(){
  tft.fillRect(0, 0, 128, 80, BLACK);
}

void printText(char *text, uint16_t color, int x, int y,int textSize)
{
  tft.setCursor(x, y);
  tft.setTextColor(color);
  tft.setTextSize(textSize);
  tft.setTextWrap(true);
  tft.print(text);
}

void Coi(){
  for(int i = 0; i < 3; i++){
      digitalWrite(buzzer, HIGH);
      delay(1000);
      digitalWrite(buzzer, LOW);
      delay(1000);
    }
}

float XuLiKhoangCach(){
  // Clears the trigPin
  digitalWrite(trigPin, LOW);
  delayMicroseconds(2);
  // Sets the trigPin on HIGH state for 10 micro seconds
  digitalWrite(trigPin, HIGH);
  delayMicroseconds(10);
  digitalWrite(trigPin, LOW);
  
  // Reads the echoPin, returns the sound wave travel time in microseconds
  duration = pulseIn(echoPin, HIGH);
  
  // Calculate the distance
  distance = duration * SOUND_SPEED/2;
  return distance;
}

void HienThiNhietDo(float ObjectTemp){
  dtostrf(ObjectTemp,5, 2, disTemp); 
  tft.setCursor(30, 120);
  tft.setTextColor(WHITE,BLACK);
  tft.setTextSize(2);
  tft.print(disTemp);
}
void HienThiCanhBaoXa(){
    XoaHienThi();
    tft.drawRGBBitmap(50, 10, Warning, 30, 24);
    tft.drawRect(0, 47, 128, 25, RED);
    printText("Vui long dung gan !", WHITE, 10, 55, 1);
}

void HienThiLoading(){
    XoaHienThi();
    tft.drawRGBBitmap(0, 10, Loading, 128, 42);
    tft.drawRect(0, 47, 128, 25, YELLOW);
    printText("Vui long giu yen !", WHITE, 10, 55, 1);
}

void HienThiNhietDoThap(){
    XoaHienThi();
    tft.drawRGBBitmap(50, 10, Warning, 30, 30);
    tft.drawRect(0, 47, 128, 25, BLUE);
    printText("Nhiet do qua thap !", BLUE, 10, 55, 1);
}

void HienThiSot(){
    XoaHienThi();
    tft.drawRGBBitmap(50, 10, Virus, 30, 30);
    tft.drawRect(0, 47, 128, 25, RED);
    printText("Ban dang bi sot", RED, 10, 55, 1);
}

void HienThiAnToan(){
    XoaHienThi();
    tft.drawRGBBitmap(50, 10, TichXanh, 30, 30);
    tft.drawRect(0, 47, 128, 25, GREEN);
    printText("Nhiet do binh thuong", GREEN, 5, 55, 1);
}

void XuLiNhietDo(){
  if(distance > maximumRange){
    objectTemp = 0;
    HienThiNhietDo(objectTemp);
    HienThiCanhBaoXa();
    delay(1000);
  }
  if((distance >= minimumRange) && (distance <= maximumRange)){
    // đo 5 lần lấy trung bình
    if(readCount == 10){
        objectTemp = temp / 10;
        HienThiNhietDo(objectTemp);
        readCount = 0;
        temp = 0;
        Blynk.virtualWrite(V0, objectTemp);
        if(objectTemp <= 30){
          Serial.println(objectTemp);
          HienThiNhietDoThap();
          delay(1500);
        }else if(objectTemp >= 37.5){
          // tft hiện thị nhiệt độ, cảnh báo
          // gửi lệnh chụp ảnh đến esp32 cam qua uart
          SerialPort.println("captures");
          SerialPort.println(objectTemp);
          Blynk.logEvent("Warning");
          HienThiSot();
          Coi();
          delay(1500);
        }else{
          // tft hiện thị nhiệt độ, an toàn
          //SerialPort.println("captures");
          SerialPort.println(objectTemp);
          HienThiAnToan();
          delay(1500);
        }
    }else{
      // tft hiện thị vui lòng giữ yên 5s
      HienThiLoading();
      temp = temp + objectTemp;
      readCount++;
      delayTime = 150;
    }
  }else{
    // nếu khoảng cách sai
    temp = 0;
    delayTime = 100;
    readCount = 0;
  }
}

void setup() {
  Serial.begin(115200);
  SerialPort.begin(115200, SERIAL_8N1, 16, 17); 
  mlx.begin();
  Blynk.begin(auth, ssid, password);
  pinMode(trigPin, OUTPUT); // Sets the trigPin as an Output
  pinMode(echoPin, INPUT);  // Sets the echoPin as an Input
  pinMode(buzzer, OUTPUT);
  tft.initR(INITR_BLACKTAB);
  tft.fillScreen(ST7735_BLACK); //----------------------------------------------cài đặt màu nền
  printText("Nhiet Do", CYAN,15,80,2);
  printText("o", WHITE, 95, 115, 1);
  printText("C", WHITE, 100, 120, 2);
  tft.drawBitmap(5, 105, NhietDo, 20, 40, WHITE);
  initWifi();
}

void loop() {
  Blynk.run();
  XuLiKhoangCach();
  objectTemp = measurementError + mlx.readObjectTempC() ;  
  roomTemp = mlx.readAmbientTempC() ;  
  
  // Serial
  Serial.println("Nhiet do doi tuong:" + String(objectTemp) + ", Nhiet do phong:" + String(roomTemp));
  Serial.println("Khoang cach: " + String(distance));

  XuLiNhietDo();
  delay(delayTime);
}